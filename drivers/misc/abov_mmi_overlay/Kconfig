## drivers/misc/abov_mmi_overlay/Kconfig
```kconfig
config INPUT_ABOV_MMI_OVERLAY
        tristate "INPUT_ABOV_MMI_OVERLAY_sensor"
        depends on I2C
        default n
        help
          Say Y to enable the SAR detection application, if N here not to use the
          this SAR sensor
```
